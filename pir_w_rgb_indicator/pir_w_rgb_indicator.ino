
/*
  This sketch uses a PIR sensor to monitor for motion and uses an RGB LED indicator.
  
  PIR sensor details:
  
*/

// Pin assigned to the IR sensor input.
int pirPin = 3;

//Pins assigned to RGB LED.
int redPin = 11;
int greenPin = 10;
int bluePin = 9;

int calibrateSeconds = 30;
int minMotionOnDisplayMS = 3000; // The minimum amount of time our indicator will trigger on motion.

// Common anode RGB LED means that the long pin connects to power.
// Change this value if using a common cathode RGB LED.
const boolean commonAnode = true;

boolean wasLow = true;
boolean takeLowTime = true;

long unsigned int wentLowTick;

void setup() {
    Serial.begin(9600);
    
    // Set up IR pin to listen for readings.
    pinMode(pirPin, INPUT);
      
    // The LED in use is a Common Anode LED. So long pin goes to +5.
    pinMode(redPin, OUTPUT);
    pinMode(greenPin, OUTPUT);
    pinMode(bluePin, OUTPUT); 
    setColor(0, 0, 0);
    
    //give the sensor some time to calibrate.
    Serial.print("calibrating sensor ");
    //calibrate();
    Serial.println("...done calibrating. Sensor active.");
    
    
}

void calibrate() {
  for (int i = 0; i < calibrateSeconds; i++){
      Serial.print(".");
      delay(1000);
  }
}


void loop() {
    if (digitalRead(pirPin) == HIGH) { // Sensor is indicating motion...
       
      if (wasLow) {  // Only run this block if transitioning from low to high.
        strobeOn();   //the led visualizes the sensors output pin state
       
        // makes sure we wait for a transition to LOW before any further output is made:
        wasLow = false;            
        Serial.println("---");
        Serial.print("motion detected at ");
        Serial.print(millis() / 1000);
        Serial.println(" sec"); 
        delay(50);
      }         
    }

   if (digitalRead(pirPin) == LOW) {  // Sensor is indicating no motion.     
  
      if (!wasLow) {  // Only run this block on a transition from high to low.
        if (takeLowTime) { 
          takeLowTime = false;
          wentLowTick = millis();   //save the time of the transition from high to LOW
          Serial.print("motion ended at "); 
          Serial.print((wentLowTick) / 1000);
          Serial.println(" sec");
        }
        
        // We don't want to turn off the indicator immediately when the sensor indicates no motion.
        // To avoid flickering, we'll wait a suitable amount of time after we first receive no motion signal.
        if ((millis() - wentLowTick) > minMotionOnDisplayMS) {
          Serial.println("Setting indicator to no motion.");
          strobeOff();
          wasLow = true;   
          takeLowTime = true;
          delay(50);
        }
      }
   }
}

void strobeOn() {
    setColor(25, 25, 50);
    delay(50);
    setColor(50, 50, 75);
    delay(50);
    setColor(75, 75, 100);
    delay(50);
    setColor(100, 100, 125);
    delay(50);
    setColor(125, 124, 175);
    delay(50);
    setColor(175, 175, 225);
    delay(50);
    setColor(200, 200, 255);
}

void strobeOff() {
    delay(100);
    setColor(200, 200, 255);
    delay(300);
    setColor(175, 175, 225);
    delay(300);
    setColor(125, 124, 175);
    delay(300);
    setColor(100, 100, 125);
    delay(300);
    setColor(75, 75, 100);
    delay(300);
    setColor(50, 50, 75);
    delay(300);
    setColor(0, 0, 0);
}

void setColor(int red, int green, int blue)
{
  if (commonAnode) {
    red = 255 - red;
    green = 255 - green;
    blue = 255 - blue;
  }
  analogWrite(redPin, red);
  analogWrite(greenPin, green);
  analogWrite(bluePin, blue);  
}
